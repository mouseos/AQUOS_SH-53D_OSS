## LINUX/android/kernel-4.19/drivers/fih/Kconfig
```kconfig
#
# fih driver
#

menu "fih driver"

config FIH
	bool "fih"
	default n
	help
	  support fih

config FIH_SX3
	bool "fih_sx3"
	default n
	help
	  support fih_sx3

config FIH_SX4
	bool "fih_sx4"
	default n
	help
	  support fih_sx4

config FIH_BINF
	bool "fih_binf"
	depends on FIH
	default n
	help
	  support fih_binf

config FIH_CPU
	bool "fih_cpu"
	depends on FIH
	default n
	help
	  support fih_cpu

config FIH_DDR
	bool "fih_ddr"
	depends on FIH
	default n
	help
	  support fih_ddr

config FIH_EXP
	bool "fih_exp"
	depends on FIH
	default n
	help
	  support fih_exp

config FIH_INFO
	bool "fih_info"
	depends on FIH
	default n
	help
	  support fih_info

config FIH_MFD
	bool "fih_mfd"
	depends on FIH
	default n
	help
	  support fih_mfd

config FIH_PDD
	bool "fih_pdd"
	depends on FIH
	default n
	help
	  support fih_pdd

config FIH_SEB
	bool "fih_seb"
	depends on FIH
	default n
	help
	  support fih_seb

config FIH_SIM
	bool "fih_sim"
	depends on FIH
	default n
	help
	  support fih_sim

config FIH_TOUCH
	bool "fih_touch"
	depends on FIH
	default n
	help
	  support fih_touch

config FIH_TRAY
	bool "fih_tray"
	depends on FIH
	default n
	help
	  support fih_tray

config FIH_BATTERY
	bool "fih battery customization"
	depends on FIH
	default n
	help
	  support FIH battery customization

config SHR_BATTERY
	bool "shr_battery"
	depends on FIH
	default n
	help
	  support Sharp battery customization

endmenu
```

## LINUX/android/kernel-4.19/drivers/input/fingerprint/Fpr_Fingerprint_Card/Kconfig
```kconfig
#
# Configuration for Fingerprint Cards AB (FPC).
#
config FPC_FINGERPRINT_MULTIVENDOR
	bool "FPC multivendor compatible platform IRQ Driver"
	default n
	---help---
	 This is a FPC chipset multivendor compatible platform IRQ Driver.

config FPC_FINGERPRINT_STANDALONE
	bool "FPC SPI and IRQ Driver"
	default n
	---help---
	 This is a FPC chipset SPI and IRQ Driver.
```

## LINUX/android/kernel-4.19/drivers/input/fingerprint/Kconfig
```kconfig
#
# Fingerprint
#
menuconfig INPUT_FINGERPRINT
	bool "Fingerprint"
	help
	  Say Y here, and a list of supported fingerprint will be displayed.

if INPUT_FINGERPRINT

config MTK_FINGERPRINT_SUPPORT
	bool "Mediatek Fingerprint"
	default n
	help
	  Fingerprint mtk driver enable/disable
	  in the kernel.Say Y here if you want to
	  use mediatek fingerprint driver,fingerprint
	  driver will support fingerprint function

config MTK_FINGERPRINT_SELECT
	string "sensor type"
	default "NA"

config FPC_FINGERPRINT
	bool "FPC Driver"
	default n
	---help---
	 This is a FPC chipset Driver.

source "drivers/input/fingerprint/Fpr_Fingerprint_Card/Kconfig"

endif
```

## LINUX/android/kernel-4.19/drivers/input/touchscreen/mediatek/FT5446U/Kconfig
```kconfig
#
# Focaltech Touchscreen driver configuration
#

config TOUCHSCREEN_FT5446U
    bool "Focaltech Touchscreen"
    default n
    help
      Say Y here if you have Focaltech touch panel.
      If unsure, say N.
      
config TOUCHSCREEN_FTS_DIRECTORY
    string "Focaltech ts directory name"
    default "FT5446U"
    depends on TOUCHSCREEN_FT5446U
    
```

## LINUX/android/kernel-4.19/drivers/input/touchscreen/mediatek/sitronix_ts/Kconfig
```kconfig
#
# Sitronix Touchscreen driver configuration
#

config TOUCHSCREEN_SITRONIX_TS
    bool "Sitronix Touchscreen"
    default n
    help
        Say Y here if you have Sitronix touch panel.
        If unsure, say N.

config TOUCHSCREEN_SITRONIX_TS_RAWDATA
    bool "Sitronix ts directory name"
    default n
    depends on TOUCHSCREEN_SITRONIX_TS
```

## LINUX/android/kernel/kernel_device_modules-6.6/drivers/fih_printk/Kconfig
```kconfig
# SPDX-License-Identifier: GPL-2.0
#
# For FIH printk extensions

config FIH_PRINTK
    tristate "FIH printk extensions"
	depends on PRINTK
    help
      FIH printk extensions for battery log.
      Intercept the keyword "FIHBATTLOG" from printk and direct it to a 
      custom buffer of type SYSLOG_ACTION_GET_KERNEL_BUFFER.
```
